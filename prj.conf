## CMakeLists.txt
```
cmake_minimum_required(VERSION 3.20.0)

# The nRF52840 dongle has no debugger/VCOM, so its shell must live on USB CDC ACM.
# On other boards with a USB port, add `-S cdc-acm-console` to the west build command.
if(BOARD STREQUAL "nrf52840dongle")
  list(APPEND SNIPPET cdc-acm-console)
endif()

find_package(Zephyr REQUIRED HINTS $ENV{ZEPHYR_BASE})
project(irkollector)

target_sources(app PRIVATE
  src/main.c
  src/irk_store.c
  src/irk_service.c
  src/hid_service.c
  src/ui.c
)

# bt_keys is a Zephyr host-internal API; it is the only way to reach the peers' IRKs.
target_include_directories(app PRIVATE ${ZEPHYR_BASE}/subsys/bluetooth)
```

## Kconfig.sysbuild
```
source "share/sysbuild/Kconfig"

# On multi-core SoCs (nRF5340) this builds the Bluetooth controller image for the network core.
config NRF_DEFAULT_BLUETOOTH
	default y
```

## sysbuild.conf
```
# Use the devicetree flash partitions (the Partition Manager is deprecated and would, on the
# dongle, place the settings storage on top of the Nordic USB bootloader).
SB_CONFIG_PARTITION_MANAGER=n
```

## prj.conf
```kconfig
CONFIG_BT=y
CONFIG_BT_PERIPHERAL=y
CONFIG_BT_MAX_CONN=2
CONFIG_BT_DEVICE_NAME="IRKollector"
# The name is extended with the last two address bytes at boot, see main.c
CONFIG_BT_DEVICE_NAME_DYNAMIC=y
CONFIG_BT_DEVICE_NAME_MAX=24
# Appearance: HID keyboard. Together with the HID service UUID in the advertising data this
# makes the device show up in the regular Bluetooth settings menus on Android and iOS.
CONFIG_BT_DEVICE_APPEARANCE=961
CONFIG_BT_REMOTE_INFO=y
CONFIG_BT_REMOTE_VERSION=y
# GATT client: used to read the phone's Device Name after pairing
CONFIG_BT_GATT_CLIENT=y
# HID over GATT requires a Battery service next to HID and DIS (iOS may rely on it)
CONFIG_BT_BAS=y
CONFIG_BT_DIS=y
CONFIG_BT_DIS_PNP=y

# Pairing: Just Works bonding, bonds (and thus peer IRKs) persisted in flash
CONFIG_BT_SMP=y
CONFIG_BT_BONDABLE=y
CONFIG_BT_SMP_ALLOW_UNAUTH_OVERWRITE=y
CONFIG_BT_MAX_PAIRED=16
CONFIG_BT_KEYS_OVERWRITE_OLDEST=y
CONFIG_BT_SETTINGS=y
CONFIG_SETTINGS=y
CONFIG_FLASH=y
CONFIG_FLASH_MAP=y
CONFIG_NVS=y
CONFIG_SETTINGS_NVS=y

CONFIG_GPIO=y
CONFIG_SHELL=y
CONFIG_LOG=y
CONFIG_ASSERT=y
```

## src/main.c
```c
#include <zephyr/bluetooth/bluetooth.h>
#include <zephyr/bluetooth/conn.h>
#include <zephyr/bluetooth/gap.h>
#include <zephyr/bluetooth/gatt.h>
#include <zephyr/bluetooth/uuid.h>
#include <zephyr/kernel.h>
#include <zephyr/logging/log.h>
#include <zephyr/settings/settings.h>

#include "irk_service.h"
#include "irk_store.h"
#include "ui.h"

LOG_MODULE_REGISTER(main, LOG_LEVEL_INF);

/* The local name goes into the advertising data itself (not only the scan response): iOS lists
 * nearby devices in Settings based on the advertised name. It carries the last two address bytes
 * so that several IRKollectors can be told apart (and iOS does not reuse a cached name).
 */
static char dev_name[CONFIG_BT_DEVICE_NAME_MAX];

static struct bt_data ad[] = {
	BT_DATA_BYTES(BT_DATA_FLAGS, BT_LE_AD_GENERAL | BT_LE_AD_NO_BREDR),
	BT_DATA_BYTES(BT_DATA_GAP_APPEARANCE, BT_BYTES_LIST_LE16(CONFIG_BT_DEVICE_APPEARANCE)),
	BT_DATA_BYTES(BT_DATA_UUID16_ALL, BT_UUID_16_ENCODE(BT_UUID_HIDS_VAL),
		      BT_UUID_16_ENCODE(BT_UUID_BAS_VAL)),
	BT_DATA(BT_DATA_NAME_COMPLETE, NULL, 0), /* filled in by init_name() */
};

static const struct bt_data sd[] = {
	BT_DATA_BYTES(BT_DATA_UUID128_ALL, IRK_SVC_UUID_VAL),
};

static void init_name(void)
{
	bt_addr_le_t id;
	size_t count = 1;

	bt_id_get(&id, &count);
	snprintk(dev_name, sizeof(dev_name), "%s-%02X%02X", CONFIG_BT_DEVICE_NAME, id.a.val[1],
		 id.a.val[0]);
	bt_set_name(dev_name);

	ad[ARRAY_SIZE(ad) - 1].data = (const uint8_t *)dev_name;
	ad[ARRAY_SIZE(ad) - 1].data_len = strlen(dev_name);
}

static unsigned int num_connections;

static void adv_start(void)
{
	int err = bt_le_adv_start(BT_LE_ADV_CONN_FAST_1, ad, ARRAY_SIZE(ad), sd, ARRAY_SIZE(sd));

	if (err == -ENOMEM) {
		/* Out of connection slots: not discoverable until one is freed (see recycled()). */
		ui_set_advertising(false);
		return;
	}
	if (err && err != -EALREADY) {
		LOG_WRN("Advertising failed to start (err %d)", err);
		ui_set_advertising(false);
		return;
	}

	ui_set_advertising(true);
}

static void connected(struct bt_conn *conn, uint8_t err)
{
	char addr[BT_ADDR_LE_STR_LEN];

	bt_addr_le_to_str(bt_conn_get_dst(conn), addr, sizeof(addr));
	if (err) {
		LOG_WRN("Connection to %s failed (err 0x%02x)", addr, err);
		return;
	}

	num_connections++;
	ui_set_connected(true);
	LOG_INF("Connected: %s", addr);

	/* Allow a second phone while the first one is still connected. */
	if (num_connections < CONFIG_BT_MAX_CONN) {
		adv_start();
	}
}

static void disconnected(struct bt_conn *conn, uint8_t reason)
{
	char addr[BT_ADDR_LE_STR_LEN];

	bt_addr_le_to_str(bt_conn_get_dst(conn), addr, sizeof(addr));
	LOG_INF("Disconnected: %s (reason 0x%02x)", addr, reason);

	if (num_connections > 0) {
		num_connections--;
	}
	ui_set_connected(num_connections > 0);
}

/* The remote version info (manufacturer, Bluetooth version) often arrives after pairing. */
static void remote_info_available(struct bt_conn *conn, struct bt_conn_remote_info *remote)
{
	struct bt_conn_info info;
	uint8_t irk[IRK_LEN];

	if (remote->type != BT_CONN_TYPE_LE || bt_conn_get_info(conn, &info) != 0 ||
	    !irk_store_find(info.id, info.le.dst, irk)) {
		return;
	}

	irk_store_set_info(info.le.dst, remote->manufacturer, remote->version);
	irk_store_log_manufacturer(info.le.dst);
}

static void recycled(void)
{
	adv_start();
}

BT_CONN_CB_DEFINE(conn_cbs) = {
	.connected = connected,
	.disconnected = disconnected,
	.recycled = recycled,
	.remote_info_available = remote_info_available,
};

/* Reading the phone's GAP Device Name is asynchronous; one context per possible connection. */
struct name_read {
	struct bt_gatt_read_params params;
	bt_addr_le_t peer;
	char name[IRK_NAME_MAX];
	size_t len;
};

static struct name_read name_reads[CONFIG_BT_MAX_CONN];

static uint8_t name_read_cb(struct bt_conn *conn, uint8_t err, struct bt_gatt_read_params *params,
			    const void *data, uint16_t length)
{
	struct name_read *r = CONTAINER_OF(params, struct name_read, params);

	if (err == 0 && data != NULL) {
		size_t n = MIN(length, sizeof(r->name) - 1 - r->len);

		memcpy(&r->name[r->len], data, n);
		r->len += n;
		return BT_GATT_ITER_CONTINUE;
	}

	if (r->len > 0) {
		irk_store_set_name(&r->peer, r->name, r->len);
		LOG_INF("  Name: %s", r->name);
	}
	return BT_GATT_ITER_STOP;
}

static void read_peer_name(struct bt_conn *conn, const bt_addr_le_t *peer)
{
	struct name_read *r = &name_reads[bt_conn_index(conn)];

	memset(r, 0, sizeof(*r));
	bt_addr_le_copy(&r->peer, peer);
	r->params.func = name_read_cb;
	r->params.handle_count = 0;
	r->params.by_uuid.uuid = BT_UUID_GAP_DEVICE_NAME;
	r->params.by_uuid.start_handle = BT_ATT_FIRST_ATTRIBUTE_HANDLE;
	r->params.by_uuid.end_handle = BT_ATT_LAST_ATTRIBUTE_HANDLE;

	int err = bt_gatt_read(conn, &r->params);

	if (err) {
		LOG_DBG("Could not read the peer's device name (err %d)", err);
	}
}

static void pairing_complete(struct bt_conn *conn, bool bonded)
{
	struct bt_conn_info info;
	struct bt_conn_remote_info remote;
	uint8_t irk[IRK_LEN];

	if (bt_conn_get_info(conn, &info) != 0) {
		return;
	}

	if (!irk_store_find(info.id, info.le.dst, irk)) {
		LOG_WRN("Paired (bonded: %d) but the peer did not distribute an IRK", bonded);
		return;
	}

	if (bt_conn_get_remote_info(conn, &remote) == 0 && remote.type == BT_CONN_TYPE_LE) {
		irk_store_set_info(info.le.dst, remote.manufacturer, remote.version);
	}

	irk_store_log(info.le.dst, irk);
	ui_irk_captured();
	read_peer_name(conn, info.le.dst);
}

static void pairing_failed(struct bt_conn *conn, enum bt_security_err reason)
{
	LOG_WRN("Pairing failed (reason %d)", reason);
}

static void bond_deleted(uint8_t id, const bt_addr_le_t *peer)
{
	irk_store_forget(peer);
}

static struct bt_conn_auth_info_cb auth_info_cbs = {
	.pairing_complete = pairing_complete,
	.pairing_failed = pairing_failed,
	.bond_deleted = bond_deleted,
};

int main(void)
{
	int err;

	ui_init();

	err = bt_conn_auth_info_cb_register(&auth_info_cbs);
	if (err) {
		LOG_ERR("Registering auth info callbacks failed (err %d)", err);
		return 0;
	}

	err = bt_enable(NULL);
	if (err) {
		LOG_ERR("Bluetooth init failed (err %d)", err);
		return 0;
	}

	settings_load();
	init_name();

	adv_start();
	LOG_INF("IRKollector ready. Pair with \"%s\"; use `irk list` to read stored IRKs.",
		dev_name);

	return 0;
}
```

## src/hid_service.c
```c
#include <zephyr/bluetooth/bluetooth.h>
#include <zephyr/bluetooth/gatt.h>
#include <zephyr/bluetooth/uuid.h>

#include "hid_service.h"

static const uint8_t hid_info[] = {
	0x11, 0x01, /* bcdHID 1.11 */
	0x00,       /* bCountryCode */
	0x02,       /* flags: normally connectable */
};

static const uint8_t report_map[] = {
	0x05, 0x01, 0x09, 0x06, 0xA1, 0x01, /* Generic Desktop, Keyboard, Application */
	0x05, 0x07, 0x19, 0xE0, 0x29, 0xE7, /* Modifier keys */
	0x15, 0x00, 0x25, 0x01, 0x75, 0x01, 0x95, 0x08, 0x81, 0x02,
	0x95, 0x01, 0x75, 0x08, 0x81, 0x01, /* Reserved byte */
	0x95, 0x05, 0x75, 0x01, 0x05, 0x08, 0x19, 0x01, 0x29, 0x05, 0x91, 0x02, /* LEDs */
	0x95, 0x01, 0x75, 0x03, 0x91, 0x01,
	0x95, 0x06, 0x75, 0x08, 0x15, 0x00, 0x25, 0x65, /* Key array */
	0x05, 0x07, 0x19, 0x00, 0x29, 0x65, 0x81, 0x00,
	0xC0,
};

static const uint8_t input_report_ref[] = {0x00, 0x01}; /* report ID 0, input */
static uint8_t input_report[8];

static ssize_t read_const(struct bt_conn *conn, const struct bt_gatt_attr *attr, void *buf,
			  uint16_t len, uint16_t offset)
{
	/* attr->user_data points at a bt_gatt_chrc-independent descriptor, see below */
	return bt_gatt_attr_read(conn, attr, buf, len, offset, attr->user_data,
				 attr->user_data == report_map ? sizeof(report_map) :
				 attr->user_data == hid_info ? sizeof(hid_info) :
				 sizeof(input_report_ref));
}

static ssize_t read_report(struct bt_conn *conn, const struct bt_gatt_attr *attr, void *buf,
			   uint16_t len, uint16_t offset)
{
	return bt_gatt_attr_read(conn, attr, buf, len, offset, input_report, sizeof(input_report));
}

static ssize_t write_ctrl_point(struct bt_conn *conn, const struct bt_gatt_attr *attr,
				const void *buf, uint16_t len, uint16_t offset, uint8_t flags)
{
	return len;
}

static void report_ccc_changed(const struct bt_gatt_attr *attr, uint16_t value)
{
}

/* Every access requires encryption: that is what makes the phone pair when the user taps the
 * device in the Bluetooth menu.
 */
BT_GATT_SERVICE_DEFINE(hid_svc,
	BT_GATT_PRIMARY_SERVICE(BT_UUID_HIDS),
	BT_GATT_CHARACTERISTIC(BT_UUID_HIDS_INFO, BT_GATT_CHRC_READ, BT_GATT_PERM_READ_ENCRYPT,
			       read_const, NULL, (void *)hid_info),
	BT_GATT_CHARACTERISTIC(BT_UUID_HIDS_REPORT_MAP, BT_GATT_CHRC_READ,
			       BT_GATT_PERM_READ_ENCRYPT, read_const, NULL, (void *)report_map),
	BT_GATT_CHARACTERISTIC(BT_UUID_HIDS_REPORT, BT_GATT_CHRC_READ | BT_GATT_CHRC_NOTIFY,
			       BT_GATT_PERM_READ_ENCRYPT, read_report, NULL, NULL),
	BT_GATT_CCC(report_ccc_changed, BT_GATT_PERM_READ_ENCRYPT | BT_GATT_PERM_WRITE_ENCRYPT),
	BT_GATT_DESCRIPTOR(BT_UUID_HIDS_REPORT_REF, BT_GATT_PERM_READ_ENCRYPT, read_const, NULL,
			   (void *)input_report_ref),
	BT_GATT_CHARACTERISTIC(BT_UUID_HIDS_CTRL_POINT, BT_GATT_CHRC_WRITE_WITHOUT_RESP,
			       BT_GATT_PERM_WRITE, NULL, write_ctrl_point, NULL),
);
```

## src/hid_service.h
```c
#ifndef HID_SERVICE_H_
#define HID_SERVICE_H_

/* A minimal, silent HID-over-GATT keyboard. It exists only so that phones list the device in
 * their normal Bluetooth menu and pair with it when the user taps it.
 */

#endif /* HID_SERVICE_H_ */
```

## src/irk_service.c
```c
#include <zephyr/bluetooth/bluetooth.h>
#include <zephyr/bluetooth/conn.h>
#include <zephyr/bluetooth/gatt.h>
#include <zephyr/logging/log.h>

#include "irk_service.h"
#include "irk_store.h"

LOG_MODULE_REGISTER(irk_service, LOG_LEVEL_INF);

static const struct bt_uuid_128 irk_svc_uuid = BT_UUID_INIT_128(IRK_SVC_UUID_VAL);
static const struct bt_uuid_128 irk_hex_uuid = BT_UUID_INIT_128(IRK_HEX_CHRC_UUID_VAL);
static const struct bt_uuid_128 irk_raw_uuid = BT_UUID_INIT_128(IRK_RAW_CHRC_UUID_VAL);

/* Only ever hand out the IRK of the connected peer itself. */
static bool get_peer_irk(struct bt_conn *conn, uint8_t irk[IRK_LEN])
{
	struct bt_conn_info info;

	if (bt_conn_get_info(conn, &info) != 0 || info.type != BT_CONN_TYPE_LE) {
		return false;
	}

	return irk_store_find(info.id, info.le.dst, irk);
}

static ssize_t read_hex(struct bt_conn *conn, const struct bt_gatt_attr *attr, void *buf,
			uint16_t len, uint16_t offset)
{
	uint8_t irk[IRK_LEN];
	char hex[2 * IRK_LEN];
	char tmp[2 * IRK_LEN + 1];

	if (!get_peer_irk(conn, irk)) {
		return BT_GATT_ERR(BT_ATT_ERR_UNLIKELY);
	}

	irk_store_hex_msb(irk, tmp);
	memcpy(hex, tmp, sizeof(hex));
	return bt_gatt_attr_read(conn, attr, buf, len, offset, hex, sizeof(hex));
}

static ssize_t read_raw(struct bt_conn *conn, const struct bt_gatt_attr *attr, void *buf,
			uint16_t len, uint16_t offset)
{
	uint8_t irk[IRK_LEN];

	if (!get_peer_irk(conn, irk)) {
		return BT_GATT_ERR(BT_ATT_ERR_UNLIKELY);
	}

	return bt_gatt_attr_read(conn, attr, buf, len, offset, irk, sizeof(irk));
}

/* Reads require an encrypted link, so a phone is made to pair before it can read its IRK. */
BT_GATT_SERVICE_DEFINE(irk_svc,
	BT_GATT_PRIMARY_SERVICE(&irk_svc_uuid),
	BT_GATT_CHARACTERISTIC(&irk_hex_uuid.uuid, BT_GATT_CHRC_READ, BT_GATT_PERM_READ_ENCRYPT,
			       read_hex, NULL, NULL),
	BT_GATT_CUD("Your IRK, hex text, MSB first", BT_GATT_PERM_READ),
	BT_GATT_CHARACTERISTIC(&irk_raw_uuid.uuid, BT_GATT_CHRC_READ, BT_GATT_PERM_READ_ENCRYPT,
			       read_raw, NULL, NULL),
	BT_GATT_CUD("Your IRK, raw 16 bytes, LSB first (as on air)", BT_GATT_PERM_READ),
);
```

## src/irk_service.h
```c
#ifndef IRK_SERVICE_H_
#define IRK_SERVICE_H_

#include <zephyr/bluetooth/uuid.h>

/* Custom GATT service that lets a bonded peer read back its own IRK, e.g. with nRF Connect.
 * ASCII-encodes to "IRK0Collector" + 000001.
 */
#define IRK_SVC_UUID_VAL     BT_UUID_128_ENCODE(0x49524b30, 0x436f, 0x6c6c, 0x6563, 0x746f72000001)
#define IRK_HEX_CHRC_UUID_VAL BT_UUID_128_ENCODE(0x49524b30, 0x436f, 0x6c6c, 0x6563, 0x746f72000002)
#define IRK_RAW_CHRC_UUID_VAL BT_UUID_128_ENCODE(0x49524b30, 0x436f, 0x6c6c, 0x6563, 0x746f72000003)

#endif /* IRK_SERVICE_H_ */
```

## src/irk_store.c
```c
#include <stdio.h>
#include <string.h>
#include <zephyr/bluetooth/bluetooth.h>
#include <zephyr/logging/log.h>
#include <zephyr/settings/settings.h>
#include <zephyr/shell/shell.h>

#include "host/keys.h"
#include "irk_store.h"
#include "ui.h"

LOG_MODULE_REGISTER(irk_store, LOG_LEVEL_INF);

bool irk_store_find(uint8_t id, const bt_addr_le_t *peer, uint8_t irk[IRK_LEN])
{
	struct bt_keys *keys = bt_keys_find(BT_KEYS_IRK, id, peer);

	if (keys == NULL) {
		return false;
	}

	memcpy(irk, keys->irk.val, IRK_LEN);
	return true;
}

void irk_store_hex_msb(const uint8_t irk[IRK_LEN], char *out)
{
	for (int i = 0; i < IRK_LEN; i++) {
		sprintf(&out[2 * i], "%02X", irk[IRK_LEN - 1 - i]);
	}
}

void irk_store_hex_lsb(const uint8_t irk[IRK_LEN], char *out)
{
	for (int i = 0; i < IRK_LEN; i++) {
		sprintf(&out[2 * i], "%02X", irk[i]);
	}
}

/* ---- Peer metadata ----------------------------------------------------------------------- */

struct peer_meta {
	bool used;
	bt_addr_le_t addr;
	uint32_t seq; /* pairing order, 1 = first */
	uint16_t company;
	uint8_t ll_version;
	char name[IRK_NAME_MAX];
};

static struct peer_meta metas[CONFIG_BT_MAX_PAIRED];
static uint32_t last_seq;

static void meta_key(const bt_addr_le_t *addr, char *out, size_t len)
{
	snprintf(out, len, "irkmeta/%02X%02X%02X%02X%02X%02X%u", addr->a.val[5], addr->a.val[4],
		 addr->a.val[3], addr->a.val[2], addr->a.val[1], addr->a.val[0], addr->type);
}

static struct peer_meta *meta_find(const bt_addr_le_t *addr)
{
	for (size_t i = 0; i < ARRAY_SIZE(metas); i++) {
		if (metas[i].used && bt_addr_le_eq(&metas[i].addr, addr)) {
			return &metas[i];
		}
	}
	return NULL;
}

/* Existing entry, a free one, or (when full) the oldest one. */
static struct peer_meta *meta_get(const bt_addr_le_t *addr)
{
	struct peer_meta *m = meta_find(addr);
	struct peer_meta *oldest = &metas[0];

	if (m != NULL) {
		return m;
	}

	for (size_t i = 0; i < ARRAY_SIZE(metas); i++) {
		if (!metas[i].used) {
			oldest = &metas[i];
			break;
		}
		if (metas[i].seq < oldest->seq) {
			oldest = &metas[i];
		}
	}

	memset(oldest, 0, sizeof(*oldest));
	oldest->used = true;
	bt_addr_le_copy(&oldest->addr, addr);
	oldest->seq = ++last_seq;
	return oldest;
}

static void meta_save(const struct peer_meta *m)
{
	char key[40];

	meta_key(&m->addr, key, sizeof(key));
	settings_save_one(key, m, sizeof(*m));
}

static int meta_set(const char *key, size_t len, settings_read_cb read_cb, void *cb_arg)
{
	struct peer_meta m;

	if (len != sizeof(m) || read_cb(cb_arg, &m, sizeof(m)) != sizeof(m)) {
		return -EINVAL;
	}

	struct peer_meta *slot = meta_get(&m.addr);

	*slot = m;
	slot->used = true;
	if (m.seq > last_seq) {
		last_seq = m.seq;
	}
	return 0;
}

SETTINGS_STATIC_HANDLER_DEFINE(irkmeta, "irkmeta", NULL, meta_set, NULL, NULL);

void irk_store_set_info(const bt_addr_le_t *peer, uint16_t company, uint8_t ll_version)
{
	struct peer_meta *m = meta_get(peer);

	m->company = company;
	m->ll_version = ll_version;
	meta_save(m);
}

void irk_store_set_name(const bt_addr_le_t *peer, const char *name, size_t len)
{
	struct peer_meta *m = meta_get(peer);

	len = MIN(len, sizeof(m->name) - 1);
	memcpy(m->name, name, len);
	m->name[len] = '\0';
	meta_save(m);
}

void irk_store_forget(const bt_addr_le_t *peer)
{
	struct peer_meta *m = meta_find(peer);
	char key[40];

	if (m == NULL) {
		return;
	}

	meta_key(&m->addr, key, sizeof(key));
	settings_delete(key);
	memset(m, 0, sizeof(*m));
}

static const char *company_name(uint16_t id)
{
	switch (id) {
	case 0x0006: return "Microsoft";
	case 0x004C: return "Apple";
	case 0x0059: return "Nordic Semiconductor";
	case 0x0075: return "Samsung";
	case 0x00E0: return "Google";
	case 0x027D: return "Huawei";
	case 0x038F: return "Xiaomi";
	case 0x0171: return "Amazon";
	case 0x000F: return "Broadcom";
	case 0x000D: return "Texas Instruments";
	case 0x0046: return "MediaTek";
	case 0x000A: return "Qualcomm";
	case 0x001D: return "Qualcomm";
	default: return NULL;
	}
}

static const char *bt_version_name(uint8_t ll_version)
{
	static const char *const names[] = {"4.0", "4.1", "4.2", "5.0", "5.1", "5.2",
					    "5.3", "5.4", "6.0", "6.1", "6.2"};

	if (ll_version >= 6 && ll_version - 6 < ARRAY_SIZE(names)) {
		return names[ll_version - 6];
	}
	return "?";
}

static const char *addr_kind(const bt_addr_le_t *addr)
{
	if (addr->type == BT_ADDR_LE_PUBLIC || addr->type == BT_ADDR_LE_PUBLIC_ID) {
		return "public";
	}
	return BT_ADDR_IS_STATIC(&addr->a) ? "random static" : "random (non-static)";
}

void irk_store_log_manufacturer(const bt_addr_le_t *peer)
{
	const struct peer_meta *m = meta_find(peer);

	if (m != NULL && m->ll_version != 0) {
		const char *co = company_name(m->company);

		LOG_INF("  Manufacturer: %s (0x%04X), Bluetooth %s", co ? co : "unknown",
			m->company, bt_version_name(m->ll_version));
	}
}

#define DESC_LINES    4
#define DESC_LINE_LEN 80

/* Fill `lines` with one human readable fact per line, returns the number of lines. */
static int describe_peer(const bt_addr_le_t *addr, char lines[DESC_LINES][DESC_LINE_LEN])
{
	const struct peer_meta *m = meta_find(addr);
	int n = 0;

	snprintf(lines[n++], DESC_LINE_LEN, "  Address type: %s", addr_kind(addr));
	if (m == NULL) {
		snprintf(lines[n++], DESC_LINE_LEN, "  Device info: not recorded");
		return n;
	}

	snprintf(lines[n++], DESC_LINE_LEN, "  Name: %s",
		 m->name[0] ? m->name : "(not read yet, or not exposed)");
	if (m->ll_version != 0) {
		const char *co = company_name(m->company);

		snprintf(lines[n++], DESC_LINE_LEN, "  Manufacturer: %s (0x%04X), Bluetooth %s",
			 co ? co : "unknown", m->company, bt_version_name(m->ll_version));
	}
	snprintf(lines[n++], DESC_LINE_LEN, "  Paired as device #%u (pairing order)",
		 (unsigned int)m->seq);
	return n;
}

void irk_store_log(const bt_addr_le_t *peer, const uint8_t irk[IRK_LEN])
{
	char addr[BT_ADDR_LE_STR_LEN];
	char msb[2 * IRK_LEN + 1];
	char lsb[2 * IRK_LEN + 1];

	bt_addr_le_to_str(peer, addr, sizeof(addr));
	irk_store_hex_msb(irk, msb);
	irk_store_hex_lsb(irk, lsb);

	LOG_INF("IRK of %s", addr);
	LOG_INF("  MSB first: %s", msb);
	LOG_INF("  LSB first: %s  (as sent over the air)", lsb);

	char lines[DESC_LINES][DESC_LINE_LEN];
	int n = describe_peer(peer, lines);

	for (int i = 0; i < n; i++) {
		LOG_INF("%s", lines[i]);
	}
}

void irk_store_clear_all(void)
{
	int err = bt_unpair(BT_ID_DEFAULT, NULL);

	if (err) {
		LOG_ERR("Failed to clear bonds (err %d)", err);
	} else {
		LOG_INF("All bonds cleared");
	}
}

static void print_key(struct bt_keys *keys, void *data)
{
	const struct shell *sh = data;
	char addr[BT_ADDR_LE_STR_LEN];
	char msb[2 * IRK_LEN + 1];
	char lsb[2 * IRK_LEN + 1];

	bt_addr_le_to_str(&keys->addr, addr, sizeof(addr));
	irk_store_hex_msb(keys->irk.val, msb);
	irk_store_hex_lsb(keys->irk.val, lsb);

	shell_print(sh, "%s", addr);
	shell_print(sh, "  MSB first: %s", msb);
	shell_print(sh, "  LSB first: %s", lsb);

	char lines[DESC_LINES][DESC_LINE_LEN];
	int n = describe_peer(&keys->addr, lines);

	for (int i = 0; i < n; i++) {
		shell_print(sh, "%s", lines[i]);
	}
}

static int cmd_list(const struct shell *sh, size_t argc, char **argv)
{
	shell_print(sh, "Stored peer IRKs:");
	bt_keys_foreach_type(BT_KEYS_IRK, print_key, (void *)sh);
	return 0;
}

static int cmd_clear(const struct shell *sh, size_t argc, char **argv)
{
	irk_store_clear_all();
	return 0;
}

static int cmd_own(const struct shell *sh, size_t argc, char **argv)
{
	bt_addr_le_t addrs[CONFIG_BT_ID_MAX];
	size_t count = ARRAY_SIZE(addrs);
	char str[BT_ADDR_LE_STR_LEN];

	bt_id_get(addrs, &count);
	for (size_t i = 0; i < count; i++) {
		bt_addr_le_to_str(&addrs[i], str, sizeof(str));
		shell_print(sh, "Own identity %zu: %s", i, str);
	}
	return 0;
}

SHELL_STATIC_SUBCMD_SET_CREATE(irk_cmds,
	SHELL_CMD(list, NULL, "List the IRKs of all bonded peers", cmd_list),
	SHELL_CMD(clear, NULL, "Remove all bonds and IRKs", cmd_clear),
	SHELL_CMD(own, NULL, "Show the device's own identity address", cmd_own),
	SHELL_SUBCMD_SET_END);

SHELL_CMD_REGISTER(irk, &irk_cmds, "IRK collector commands", NULL);
```

## src/irk_store.h
```c
#ifndef IRK_STORE_H_
#define IRK_STORE_H_

#include <stdbool.h>
#include <stddef.h>
#include <stdint.h>
#include <zephyr/bluetooth/addr.h>

#define IRK_LEN 16

/* Look up the IRK distributed by `peer` during pairing. The IRK is returned in the order Zephyr
 * stores it, which is the order on air (least significant byte first).
 */
bool irk_store_find(uint8_t id, const bt_addr_le_t *peer, uint8_t irk[IRK_LEN]);

/* Hex string, most significant byte first (i.e. the stored bytes reversed). `out` must hold
 * 2 * IRK_LEN + 1 bytes.
 */
void irk_store_hex_msb(const uint8_t irk[IRK_LEN], char *out);

/* Hex string in stored/on-air order (least significant byte first). */
void irk_store_hex_lsb(const uint8_t irk[IRK_LEN], char *out);

/* Log a captured IRK, in both byte orders, together with what is known about the peer. */
void irk_store_log(const bt_addr_le_t *peer, const uint8_t irk[IRK_LEN]);

/* Peer metadata, kept in flash next to the bond. Set at pairing; an empty name or a zero version
 * means "not known (yet)".
 */
#define IRK_NAME_MAX 32

void irk_store_set_info(const bt_addr_le_t *peer, uint16_t company, uint8_t ll_version);
void irk_store_set_name(const bt_addr_le_t *peer, const char *name, size_t len);
/* Log just the manufacturer/version line, for info that arrives after the IRK was logged. */
void irk_store_log_manufacturer(const bt_addr_le_t *peer);
void irk_store_forget(const bt_addr_le_t *peer);

/* Remove all bonds (and with them all stored IRKs). */
void irk_store_clear_all(void);

#endif /* IRK_STORE_H_ */
```

## src/ui.c
```c
#include <zephyr/drivers/gpio.h>
#include <zephyr/kernel.h>
#include <zephyr/logging/log.h>

#include "irk_store.h"
#include "ui.h"

LOG_MODULE_REGISTER(ui, LOG_LEVEL_INF);

#if DT_NODE_HAS_STATUS(DT_ALIAS(led0), okay)
static const struct gpio_dt_spec led = GPIO_DT_SPEC_GET(DT_ALIAS(led0), gpios);
#define HAS_LED 1
#endif

#if DT_NODE_HAS_STATUS(DT_ALIAS(sw0), okay)
static const struct gpio_dt_spec button = GPIO_DT_SPEC_GET(DT_ALIAS(sw0), gpios);
static struct gpio_callback button_cb_data;
static struct k_work_delayable clear_work;
#define HAS_BUTTON 1
#endif

/* LED patterns: advertising and not connected = short pulse once a second, connected = solid,
 * IRK captured = a few fast blinks on top of either.
 */
#define HEARTBEAT_ON_MS  100
#define HEARTBEAT_OFF_MS 900

static struct k_work_delayable blink_work;
static struct k_work_delayable heartbeat_work;
static bool connected;
static bool advertising;
static bool heartbeat_on;
static int blinks_left;

static void led_set(bool on)
{
#ifdef HAS_LED
	gpio_pin_set_dt(&led, on);
#endif
}

static void heartbeat_handler(struct k_work *work)
{
	if (connected || !advertising) {
		heartbeat_on = false;
		if (blinks_left == 0) {
			led_set(connected);
		}
		return;
	}

	heartbeat_on = !heartbeat_on;
	if (blinks_left == 0) {
		led_set(heartbeat_on);
	}
	k_work_schedule(&heartbeat_work, K_MSEC(heartbeat_on ? HEARTBEAT_ON_MS : HEARTBEAT_OFF_MS));
}

static void blink_handler(struct k_work *work)
{
	if (blinks_left == 0) {
		led_set(connected || (advertising && heartbeat_on));
		return;
	}

	/* Even remaining counts are "off" phases. */
	led_set(blinks_left % 2);
	blinks_left--;
	k_work_schedule(&blink_work, K_MSEC(120));
}

void ui_set_connected(bool is_connected)
{
	connected = is_connected;
	k_work_reschedule(&heartbeat_work, K_NO_WAIT);
}

void ui_set_advertising(bool is_advertising)
{
	advertising = is_advertising;
	k_work_reschedule(&heartbeat_work, K_NO_WAIT);
}

void ui_irk_captured(void)
{
	blinks_left = 6;
	k_work_schedule(&blink_work, K_NO_WAIT);
}

#ifdef HAS_BUTTON
static void clear_handler(struct k_work *work)
{
	LOG_INF("Button held, clearing all bonds");
	irk_store_clear_all();
	ui_irk_captured();
}

static void button_isr(const struct device *dev, struct gpio_callback *cb, uint32_t pins)
{
	if (gpio_pin_get_dt(&button)) {
		k_work_schedule(&clear_work, K_MSEC(UI_CLEAR_HOLD_MS));
	} else {
		k_work_cancel_delayable(&clear_work);
	}
}
#endif

void ui_init(void)
{
	k_work_init_delayable(&blink_work, blink_handler);
	k_work_init_delayable(&heartbeat_work, heartbeat_handler);

#ifdef HAS_LED
	if (gpio_is_ready_dt(&led)) {
		gpio_pin_configure_dt(&led, GPIO_OUTPUT_INACTIVE);
	}
#endif

#ifdef HAS_BUTTON
	k_work_init_delayable(&clear_work, clear_handler);
	if (gpio_is_ready_dt(&button)) {
		gpio_pin_configure_dt(&button, GPIO_INPUT);
		gpio_pin_interrupt_configure_dt(&button, GPIO_INT_EDGE_BOTH);
		gpio_init_callback(&button_cb_data, button_isr, BIT(button.pin));
		gpio_add_callback(button.port, &button_cb_data);
	}
#endif
}
```

## src/ui.h
```c
#ifndef UI_H_
#define UI_H_

#include <stdbool.h>

/* LED + button. The LED pulses once a second while advertising (discoverable), is solid while a
 * phone is connected, and blinks quickly when an IRK was captured.
 * Holding the button for UI_CLEAR_HOLD_MS clears all bonds.
 */
#define UI_CLEAR_HOLD_MS 3000

void ui_init(void);
void ui_set_connected(bool connected);
void ui_set_advertising(bool advertising);
void ui_irk_captured(void);

#endif /* UI_H_ */
```
